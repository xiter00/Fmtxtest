

#include <Wire.h>
#include <Adafruit_GFX.h>
#include <Adafruit_SSD1306.h>

// ====== EDIT PIN DI SINI ======
#define SDA_PIN   3
#define SCL_PIN   4
// ================================

#define SCREEN_WIDTH   128
#define SCREEN_HEIGHT  64
#define OLED_RESET     -1
#define SCREEN_ADDRESS 0x3C

Adafruit_SSD1306 display(SCREEN_WIDTH, SCREEN_HEIGHT, &Wire, OLED_RESET);

// ====== UKURAN BITMAP QRIS ======
// Total byte array = 280.
// 280 byte x 8 bit = 2240 bit -> cocok untuk bitmap 56 x 40 (56*40/8 = 280).
// Jika ukuran gambar QRIS kamu sebenarnya berbeda, ubah nilai di bawah ini
// agar (QRIS_W * QRIS_H) / 8 == jumlah elemen array.
#define QRIS_W 58
#define QRIS_H 58

// Bitmap format VERTICAL (page-based, seperti output image2cpp mode "Vertical")
static const unsigned char PROGMEM qris_bitmap[] = {
0xff, 0xff, 0x03, 0xfb, 0x8b, 0x8b, 0x8b, 0xfb, 0x03, 0xff, 0x57, 0x6f, 0x17, 0x47, 0x03, 0xaf,
0xcf, 0xf7, 0x43, 0x6b, 0x93, 0x17, 0xdf, 0x2f, 0xff, 0x57, 0x0f, 0x97, 0x97, 0xaf, 0x37, 0x2f,
0xa7, 0x6b, 0xbb, 0x93, 0x5b, 0x4b, 0x47, 0x4f, 0x9b, 0xd7, 0x9b, 0xe3, 0x13, 0xe7, 0xdf, 0xff,
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0x03, 0x03, 0x03, 0x03, 0x03, 0x03, 0x03, 0x03, 0x03, 0x03, 0x03, 0x03, 0x03, 0x03, 0x03, 0x03
};

// Fungsi menggambar bitmap format VERTICAL (page-based) secara manual,
// karena Adafruit_GFX drawBitmap() bawaan defaultnya HORIZONTAL.
void drawBitmapVertical(int16_t x, int16_t y, const uint8_t *bitmap,
                         int16_t w, int16_t h, uint16_t color) {
  int16_t pages = (h + 7) / 8;
  for (int16_t page = 0; page < pages; page++) {
    for (int16_t col = 0; col < w; col++) {
      uint8_t line = pgm_read_byte(&bitmap[page * w + col]);
      for (int8_t bit = 0; bit < 8; bit++) {
        int16_t py = page * 8 + bit;
        if (py >= h) break;
        if (line & (1 << bit)) {
          display.drawPixel(x + col, y + py, color);
        }
      }
    }
  }
}

void setup() {
  Wire.begin(SDA_PIN, SCL_PIN);

  if (!display.begin(SSD1306_SWITCHCAPVCC, SCREEN_ADDRESS)) {
    // OLED gagal init, berhenti di sini
    for (;;) delay(1000);
  }

  display.clearDisplay();

  int16_t x = (SCREEN_WIDTH  - QRIS_W) / 2;
  int16_t y = (SCREEN_HEIGHT - QRIS_H) / 2;

  drawBitmapVertical(x, y, qris_bitmap, QRIS_W, QRIS_H, SSD1306_WHITE);

  display.display();
}

void loop() {
  // Tidak ada apa-apa, gambar statis sudah tampil dari setup()
}
